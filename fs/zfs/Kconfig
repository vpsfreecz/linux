## fs/zfs/Kconfig
```kconfig
config ZFS
	tristate "ZFS filesystem support"
	depends on EFI_PARTITION
	select ZLIB_INFLATE
	select ZLIB_DEFLATE
	help
	  This is the ZFS filesystem from the OpenZFS project.

	  See https://github.com/openzfs/zfs

	  To compile this file system support as a module, choose M here.

	  If unsure, say N.
```
